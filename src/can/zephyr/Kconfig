## src/can/zephyr/Kconfig
```kconfig
# Copyright (c) The ThingSet Project Contributors
# SPDX-License-Identifier: Apache-2.0

config THINGSET_CAN_FRAME_SEPARATION_TIME
	int "ThingSet CAN minimum frame separation time"
	range 0 127
	default 1
	help
	  Minimum time in milliseconds between the end of one frame and the
	  beginning of the next consecutive frame in multi-frame messages.

	  This parameter is used for the STmin value in the underlying ISO-TP
	  protocol of request/response messages and as a delay between individual
	  frames of multi-frame reports.

config THINGSET_CAN_REPORT_SEND_TIMEOUT
	int "ThingSet CAN report send timeout"
	range 0 100
	default 30
	help
	  Timeout in milliseconds to wait for a report frame to be successfully
	  submitted to the CAN TX FIFO.

config THINGSET_CAN_NODE_ADDRESS_MIN
	hex "ThingSet CAN minimum node address"
	range 0x01 0xFD
	default 0x01
	help
	  Minimum valid address for a ThingSet CAN node.
	  Valid range is 0x01-0xFD.

config THINGSET_CAN_NODE_ADDRESS_MAX
	hex "ThingSet CAN maximum node address"
	range 0x01 0xFD
	default 0xFD
	help
	  Maximum valid address for a ThingSet CAN node.
	  Valid range is 0x01-0xFD.

rsource "isotp/Kconfig"
```

## src/ip/sockets/Kconfig
```kconfig
config THINGSET_SOCKETS_REPORT_DECODER_QUEUE_SIZE
    int "ThingSet Sockets decoder queue size for inbound report frames"
    default 8
    help
        Size of queue for report frames to be decoded by streaming
        decoder.
```

## tests/zephyr/persistence/testcase.yaml
```yaml
# SPDX-License-Identifier: Apache-2.0

tests:
  thingset++.ZephyrPersistence:
    integration_platforms:
      - native_posix/native/64
    extra_args: EXTRA_CFLAGS=-Werror
```

## tests/zephyr/testcase.yaml
```yaml
# SPDX-License-Identifier: Apache-2.0

tests:
  thingset++.ZephyrClientServer:
    integration_platforms:
      - native_sim/native/64
    extra_args: EXTRA_CFLAGS=-Werror
```

## west.yml
```yaml
manifest:
  remotes:
    - name: zephyrproject-rtos
      url-base: https://github.com/zephyrproject-rtos
    - name: NordicSemiconductor
      url-base: https://github.com/NordicSemiconductor

  projects:
    - name: zephyr
      remote: zephyrproject-rtos
      revision: v4.1-branch
      import:
        name-allowlist:
          - edtt
          - zcbor
```

## zephyr/Kconfig
```kconfig
config THINGSET_PLUS_PLUS
	bool "ThingSet C++"
	select ZCBOR
	select ZCBOR_CANONICAL

if THINGSET_PLUS_PLUS

config THINGSET_PLUS_PLUS_SERVER
	bool "Enable server"
	default false

config THINGSET_PLUS_PLUS_CLIENT
	bool "Enable client"
	default false

config THINGSET_PLUS_PLUS_PROTOCOL_TEXT
	bool "Enable text mode"
	default true

config THINGSET_PLUS_PLUS_ENHANCED_REPORTING
	bool "Enable enhanced reporting"
	default false
	help
		Automatically encode device EUI at start of payload and use a
		dedicated request type (0x1E) to denote this format

config THINGSET_PLUS_PLUS_BACKEND_CAN
	bool "Enable CAN backend"
	default false
	select CAN
	select ISOTP
	select ISOTP_FAST
	select ISOTP_FAST_FIXED_ADDRESSING

if THINGSET_PLUS_PLUS_BACKEND_CAN

config THINGSET_PLUS_PLUS_CAN_SUBSCRIPTION_THREAD_STACK_SIZE
	int "Stack size of subscription thread"
	default 1024

config THINGSET_PLUS_PLUS_CAN_CLIENT_RX_BUFFER_SIZE
	int "Size of receive buffer in client"
	default 1024

config THINGSET_PLUS_PLUS_CAN_SUBSCRIPTION_THREAD_PRIORITY
	int "Priority of subscription thread"
	default 5

config THINGSET_PLUS_PLUS_CAN_SUBSCRIPTION_QUEUE_DEPTH
	int "Number of CAN frames that can be stored in the queue"
	default 12

rsource "../src/can/zephyr/Kconfig"

endif

config THINGSET_PLUS_PLUS_BACKEND_SOCKET
	bool "Enable socket backend"
	default false
	select NETWORKING
	select NET_IPV4
	select NET_TCP
	select NET_SOCKETS

if THINGSET_PLUS_PLUS_BACKEND_SOCKET

config THINGSET_PLUS_PLUS_SOCKET_ACCEPT_THREAD_STACK_SIZE
	int "Accept thread stack size"
	default 1024

config THINGSET_PLUS_PLUS_SOCKET_ACCEPT_THREAD_PRIORITY
	int "Accept thread priority"
	default 3

config THINGSET_PLUS_PLUS_SOCKET_HANDLER_THREAD_STACK_SIZE
	int "Handler thread stack size"
	default 2048

config THINGSET_PLUS_PLUS_SOCKET_HANDLER_THREAD_PRIORITY
	int "Handler thread priority"
	default 2

endif

config THINGSET_PLUS_PLUS_BACKEND_SHELL
	bool "Enable shell backend"
	default false
	select SHELL
	select THINGSET_PLUS_PLUS_PROTOCOL_TEXT

config THINGSET_PLUS_PLUS_EEPROM
	bool "Enable saving to/loading from EEPROM"
	default false
	select EEPROM

if THINGSET_PLUS_PLUS_EEPROM

config THINGSET_PLUS_PLUS_EEPROM_CHUNK_SIZE
	int "Size of chunked writes to/reads from EEPROM"
	default 251

config THINGSET_PLUS_PLUS_EEPROM_ACCESS_ATTEMPTS
	int "Number of times to retry reading from/writing to EEPROM"
	default 3

config THINGSET_PLUS_PLUS_EEPROM_DATA_VERSION
	int "Version number of persisted data"
	range 1 65535
	default 1
	help
	  Increment this if you change the IDs of any persisted objects.

endif

module = THINGSET_PLUS_PLUS
module-str = thingsetplusplus
source "../zephyr/subsys/logging/Kconfig.template.log_config"

endif
```
